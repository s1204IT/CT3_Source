## kernel-4.4/drivers/input/touchscreen/mediatek/BU21025/Kconfig
```kconfig
#
# Touchscreen driver configuration
#
if TOUCHSCREEN_MTK_BU21025

config BU21025_CONFIG
	string "BU21025 for Mediatek config"
	
endif
```

## kernel-4.4/drivers/input/touchscreen/mediatek/Kconfig
```kconfig
#
# Touchscreen driver configuration
#
menuconfig INPUT_TOUCHSCREEN
	bool "Touchscreens"
	help
	  Say Y here, and a list of supported touchscreens will be displayed.
	  This option doesn't affect the kernel.

	  If unsure, say Y.

if INPUT_TOUCHSCREEN

config TOUCHSCREEN_MTK
	bool "MediaTek Touch Panel Driver"
	help
	  Say Y here if you have MediaTek touch panel.

	  If unsure, say N.

	  To compile this dirver as a module, choose M here: the
	  module will be called.

config TOUCHSCREEN_MTK_GT1151
	bool "GT1151 for Mediatek package"
	default n
	help
	  Say Y here if you have GT1151 touch panel.

	  If unsure, say N.

	  To compile this dirver as a module, choose M here: the
	  module will be called.

source "drivers/input/touchscreen/mediatek/GT1151/Kconfig"

config TOUCHSCREEN_MTK_GT911
	bool "GT911 for Mediatek package"
	help
	  Say Y here if you have GT911 touch panel.

	  If unsure, say N.

source "drivers/input/touchscreen/mediatek/GT911/Kconfig"

config TOUCHSCREEN_FT5X26
	bool "FT5X26 for Mediatek package"
	default n
	help
	  Say Y here if you have FT5X26 touch panel.

	  If unsure, say N.

	  To compile this dirver as a module, choose M here: the
	  module will be called.

source "drivers/input/touchscreen/mediatek/FT5X26/Kconfig"

config TOUCHSCREEN_MTK_GSLX680
	bool "gslX680 for Mediatek package"
	help
	  Say Y here if you have gslX680 touch panel.

	  If unsure, say N.


config TOUCHSCREEN_MTK_BU21025
	tristate "BU21025 based touchscreens"
	depends on I2C
	help
	  Say Y here if you have a BU21025 based touchscreen
	  controller.

	  If unsure, say N.

	  To compile this driver as a module, choose M here: the
	  module will be called bu21025_ts.

config TOUCHSCREEN_MTK_EKTF2K
	tristate "EKTF2K Touchscreen"
	help
	  Say Y here if you have EKTF2K touchscreen,
	  connected to your system.
	  If unsure, say N.
	  To compile this driver as a module, choose M here.

config TOUCHSCREEN_MTK_WACOM
	tristate "WACOM Touchscreen"
	help
	  Say Y here if you have WACOM touchscreen,
	  connected to your system.
	  If unsure, say N.
	  To compile this driver as a module, choose M here.

endif
```

## kernel-4.4/drivers/input/touchscreen/mediatek/ektf2k/Kconfig
```kconfig
#
# Touchscreen driver configuration
#
if TOUCHSCREEN_MTK_EKTF2K

config EKTF2K_CONFIG
	string "EKTF2K for Mediatek config"

endif
```

## kernel-4.4/drivers/input/touchscreen/mediatek/wacom/Kconfig
```kconfig
#
# Touchscreen driver configuration
#
if TOUCHSCREEN_MTK_WACOM

config WACOM_CONFIG
	string "wacom for Mediatek config"

endif
```

## kernel-4.4/drivers/misc/mediatek/accelerometer/lis2dh/Kconfig
```kconfig
config MTK_LIS2DH
	bool "LIS2DH for MediaTek package"
	default n
	help
		It supports different accelerometer sensor.
		If this option is set, it will support
		LIS2DH Accelerometer.
```

## kernel-4.4/drivers/misc/mediatek/accelerometer/mma8x5x/Kconfig
```kconfig
config MTK_MMA8X5X
	bool "MMA8X5X for MediaTek package"
	default n
	help
	  MMA8X5X is a system-in-package featureing a 3D digital accelerometer
	  and a 3D digital gyroscope performing at 1.1mA in high-performance
	  mode and enabling always-on low-power features for an
	  optional motion experience for the customer.
```
